&led_strip {
    compatible = "worldsemi,ws2812-spi"; // Indispensable pour que les réglages SPI s'appliquent
    chain-length = <27>;
    spi-max-frequency = <4000000>; 
    
    /* Timings optimisés pour SK6812 (nRF52) */
    spi-one-frame = <0x70>;
    spi-zero-frame = <0x40>;
    
    /* Optionnel : ordre des couleurs si les couleurs sont inversées (ex: rouge à la place du vert) */
    color-mapping = <LED_COLOR_ID_GREEN LED_COLOR_ID_RED LED_COLOR_ID_BLUE>;
};

&i2c1 {
    status = "okay";
    ssd1306: ssd1306@3c {
        compatible = "solomon,ssd1306fb";
        reg = <0x3c>;
        label = "DISPLAY";
        width = <128>;
        height = <32>;
        segment-offset = <0>;
        page-offset = <0>;
        display-offset = <0>;
        multiplex-ratio = <31>;
        segment-remap;
        com-invdir;
        com-sequential;
        prechargep = <0x22>;
    };
};
